## br2ext/package/greetd/Config.in
```kconfig
config BR2_PACKAGE_GREETD
	bool "greetd"
	depends on BR2_PACKAGE_HOST_RUSTC_TARGET_ARCH_SUPPORTS
	depends on BR2_TOOLCHAIN_HAS_THREADS
	select BR2_PACKAGE_HOST_RUSTC
	select BR2_PACKAGE_LINUX_PAM
	help
	  The login daemon: runs a greeter on a VT as its own user, does PAM
	  for the account the greeter names, and starts that account's
	  session in its place. AOS's greeter is ade-greeter on the
	  compositor; agreety, the text one, comes along for a serial line.

	  https://git.sr.ht/~kennylevinsen/greetd
```

## br2ext/package/images/Config.in
```kconfig
config BR2_PACKAGE_IMAGES
	bool "images (image viewer)"
	depends on BR2_PACKAGE_HOST_RUSTC_TARGET_ARCH_SUPPORTS
	depends on BR2_TOOLCHAIN_HAS_THREADS
	depends on !BR2_STATIC_LIBS
	select BR2_PACKAGE_HOST_RUSTC
	select BR2_PACKAGE_LIBXKBCOMMON
	select BR2_PACKAGE_VULKAN_LOADER
	select BR2_PACKAGE_WAYLAND
	help
	  The image viewer: PNG, JPEG and SVG, on the aos-sdk's picture
	  path. Walks the folder with Left and Right, zooms, pans. Files
	  opens pictures with it. Same stack and same dependencies as
	  notepad; see there for why the Vulkan loader alone is not
	  enough and where the drivers come from.

comment "images needs a toolchain w/ threads and dynamic libs"
	depends on BR2_PACKAGE_HOST_RUSTC_TARGET_ARCH_SUPPORTS
	depends on !BR2_TOOLCHAIN_HAS_THREADS || BR2_STATIC_LIBS
```

## br2ext/package/libnsl/Config.in
```kconfig
config BR2_PACKAGE_LIBNSL
	bool "libnsl"
	depends on BR2_TOOLCHAIN_HAS_THREADS # libtirpc
	depends on BR2_USE_MMU # libtirpc
	depends on !BR2_STATIC_LIBS # libtirpc
	select BR2_PACKAGE_LIBTIRPC
	help
	  The NIS/YP client library glibc dropped in 2.32, as its own
	  project on libtirpc. Nothing on AOS uses NIS; this exists
	  because Steam's steamui.so still links libnsl.so.1, so the
	  32-bit compat32 runtime carries it.

	  https://github.com/thkukuk/libnsl

comment "libnsl needs a toolchain w/ threads, dynamic library"
	depends on BR2_USE_MMU
	depends on !BR2_TOOLCHAIN_HAS_THREADS || BR2_STATIC_LIBS
```

## br2ext/package/notepad/Config.in
```kconfig
config BR2_PACKAGE_NOTEPAD
	bool "notepad (text editor)"
	depends on BR2_PACKAGE_HOST_RUSTC_TARGET_ARCH_SUPPORTS
	depends on BR2_TOOLCHAIN_HAS_THREADS
	depends on !BR2_STATIC_LIBS
	select BR2_PACKAGE_HOST_RUSTC
	select BR2_PACKAGE_LIBXKBCOMMON
	select BR2_PACKAGE_VULKAN_LOADER
	select BR2_PACKAGE_WAYLAND
	help
	  A text editor: the first AOS application that is not part of
	  the desktop itself. Built on awin (Wayland + Vulkan) and tgn
	  (the widget layer on top of it), so it is also what proves
	  that stack works on the image.

	  Run it as "notepad [file]" from a terminal in the session, or
	  put it in ADE_AUTOSTART.

	  It draws with Vulkan, which means the loader here is not
	  enough on its own -- the loader finds nothing unless an ICD is
	  also installed. There is no single symbol to depend on for
	  that, so it is not expressed here; the AOS defconfig turns on
	  the Intel, AMD, virtio and swrast Mesa drivers, and the last
	  of those is what makes this work on a machine with no Vulkan
	  hardware at all.

	  Fonts are not a runtime dependency: tgn compiles one in with
	  include_bytes!, and the keymap comes from the compositor over
	  the wl_keyboard fd, so xkeyboard-config is not needed either.

comment "notepad needs a toolchain w/ threads and dynamic libs"
	depends on BR2_PACKAGE_HOST_RUSTC_TARGET_ARCH_SUPPORTS
	depends on !BR2_TOOLCHAIN_HAS_THREADS || BR2_STATIC_LIBS
```

## br2ext/package/settings/Config.in
```kconfig
config BR2_PACKAGE_SETTINGS
	bool "settings (settings application)"
	depends on BR2_PACKAGE_HOST_RUSTC_TARGET_ARCH_SUPPORTS
	depends on BR2_TOOLCHAIN_HAS_THREADS
	depends on !BR2_STATIC_LIBS
	select BR2_PACKAGE_HOST_RUSTC
	select BR2_PACKAGE_LIBXKBCOMMON
	select BR2_PACKAGE_VULKAN_LOADER
	select BR2_PACKAGE_WAYLAND
	help
	  The settings application: network and Wi-Fi, sound, display,
	  keyboard layout, power and the lid, users, date and time,
	  updates with the third-party and XWayland switches, and
	  about. Built on awin (Wayland + Vulkan) and tgn like notepad,
	  terminal, files and sysmon, so it has the same runtime needs
	  and the same Vulkan ICD caveat described under notepad.

	  It sets nothing itself: every change goes through the tools
	  the image has -- sudo, iw and aos-wifi, wpctl, timedatectl,
	  hostnamectl, the shadow tools, apm, tee for the files under
	  /etc. There is no polkit agent, so it asks for the password
	  itself and hands it to sudo once; the seat's polkit rule
	  covers suspend, restart and power off without one.

comment "settings needs a toolchain w/ threads and dynamic libs"
	depends on BR2_PACKAGE_HOST_RUSTC_TARGET_ARCH_SUPPORTS
	depends on !BR2_TOOLCHAIN_HAS_THREADS || BR2_STATIC_LIBS
```

## br2ext/package/sof-firmware/Config.in
```kconfig
config BR2_PACKAGE_SOF_FIRMWARE
	bool "sof-firmware (Sound Open Firmware for Intel audio DSPs)"
	depends on BR2_x86_64
	help
	  The firmware and topologies for the audio DSP in Intel laptops
	  from Cannon Lake (2018) to Panther Lake and beyond, as the SOF
	  project releases them in sof-bin: the IPC3 firmware and
	  topologies for the older parts, the IPC4 ones for Meteor Lake
	  on. Without these the kernel's SOF driver loads, finds no
	  firmware, and the machine has no sound at all.

	  Intel's signed firmware is under Intel's binary licence; the
	  topologies and the community builds are BSD-3-Clause.

	  https://github.com/thesofproject/sof-bin
```

## br2ext/package/sysmon/Config.in
```kconfig
config BR2_PACKAGE_SYSMON
	bool "sysmon (system monitor)"
	depends on BR2_PACKAGE_HOST_RUSTC_TARGET_ARCH_SUPPORTS
	depends on BR2_TOOLCHAIN_HAS_THREADS
	depends on !BR2_STATIC_LIBS
	select BR2_PACKAGE_HOST_RUSTC
	select BR2_PACKAGE_LIBXKBCOMMON
	select BR2_PACKAGE_VULKAN_LOADER
	select BR2_PACKAGE_WAYLAND
	help
	  The system monitor: CPU with a history and one bar per core,
	  the graphics cards, memory and swap, network rates, the
	  mounted disks, and a process list that sorts by column and
	  ends a process with Delete (SIGTERM) or Shift+Delete
	  (SIGKILL).
	  Everything is read from /proc and sysfs, so it has no runtime
	  dependencies beyond the awin + tgn stack it shares with
	  notepad, terminal and files, and the same Vulkan ICD caveat
	  described under notepad.

	  NVIDIA figures come from NVML, libnvidia-ml.so.1 from the
	  aos-nvidia package, opened with dlopen at run time: without it
	  there is simply no NVIDIA entry, so this does not depend on
	  that package. AMD figures come from amdgpu's sysfs, Intel ones
	  from the per-client counters i915 and xe put in fdinfo, which
	  count the processes the user can read.

comment "sysmon needs a toolchain w/ threads and dynamic libs"
	depends on BR2_PACKAGE_HOST_RUSTC_TARGET_ARCH_SUPPORTS
	depends on !BR2_TOOLCHAIN_HAS_THREADS || BR2_STATIC_LIBS
```

## br2ext/package/terminal/Config.in
```kconfig
config BR2_PACKAGE_TERMINAL
	bool "terminal (terminal emulator)"
	depends on BR2_PACKAGE_HOST_RUSTC_TARGET_ARCH_SUPPORTS
	depends on BR2_TOOLCHAIN_HAS_THREADS
	depends on !BR2_STATIC_LIBS
	select BR2_PACKAGE_HOST_RUSTC
	select BR2_PACKAGE_LIBXKBCOMMON
	select BR2_PACKAGE_VULKAN_LOADER
	select BR2_PACKAGE_WAYLAND
	help
	  The AOS terminal emulator: an awin + tgn window with a pty
	  behind it and its own escape-sequence parser, on the same
	  Wayland + Vulkan stack as the rest of the desktop.

	  This is what ade's Super+Return and Super+T spawn, which is
	  why ade selects it. With no terminal on the image there is no
	  way to reach a shell from the session at all.

	  It runs $SHELL, falling back to /bin/bash, and tells it
	  TERM=xterm-256color -- an entry ncurses installs by default,
	  so no terminfo needs adding for it.

	  Like notepad it draws with Vulkan, so the loader selected here
	  finds nothing unless an ICD is installed too. There is no one
	  symbol to depend on for that; the AOS defconfig turns on the
	  Intel, AMD, virtio and swrast Mesa drivers, and swrast is what
	  makes this work on a machine with no Vulkan hardware.

	  It needs no fonts on the image: tgn's built-in face is
	  proportional and a grid cannot use it, so the terminal
	  compiles in Liberation Mono of its own.

comment "terminal needs a toolchain w/ threads and dynamic libs"
	depends on BR2_PACKAGE_HOST_RUSTC_TARGET_ARCH_SUPPORTS
	depends on !BR2_TOOLCHAIN_HAS_THREADS || BR2_STATIC_LIBS
```

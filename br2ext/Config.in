## br2ext/Config.in
```kconfig
menu "AOS foundation"

comment "Self-hosting toolchain"
comment "Buildroot does not support building a toolchain for the target"
comment "(see package/make/Config.in). AOS needs one, so it supplies gcc"
comment "and the Rust toolchain as external packages here. The matching"
comment "headers, crt files and static libraries are exported from the"
comment "staging sysroot by board/aos/post-build.sh."

source "$BR2_EXTERNAL_AOS_PATH/package/aos-gcc/Config.in"
source "$BR2_EXTERNAL_AOS_PATH/package/aos-rust/Config.in"

comment "Packages"

source "$BR2_EXTERNAL_AOS_PATH/package/apm/Config.in"

comment "Desktop"

source "$BR2_EXTERNAL_AOS_PATH/package/ade/Config.in"
source "$BR2_EXTERNAL_AOS_PATH/package/notepad/Config.in"
source "$BR2_EXTERNAL_AOS_PATH/package/terminal/Config.in"
source "$BR2_EXTERNAL_AOS_PATH/package/files/Config.in"
source "$BR2_EXTERNAL_AOS_PATH/package/sysmon/Config.in"
source "$BR2_EXTERNAL_AOS_PATH/package/settings/Config.in"

comment "Graphics"

source "$BR2_EXTERNAL_AOS_PATH/package/aos-nvidia-open/Config.in"
source "$BR2_EXTERNAL_AOS_PATH/package/aos-nvidia/Config.in"
source "$BR2_EXTERNAL_AOS_PATH/package/libnsl/Config.in"

endmenu
```

## br2ext/package/ade-greeter/Config.in
```kconfig
config BR2_PACKAGE_ADE_GREETER
	bool "ade-greeter"
	depends on BR2_PACKAGE_HOST_RUSTC_TARGET_ARCH_SUPPORTS
	select BR2_PACKAGE_HOST_RUSTC
	select BR2_PACKAGE_GREETD
	select BR2_PACKAGE_ADE
	help
	  The login screen of AOS: a greeter for greetd on the ade
	  compositor (usr/lib/aos/session --greeter).
```

## br2ext/package/ade/Config.in
```kconfig
config BR2_PACKAGE_ADE
	bool "ade (desktop environment)"
	depends on BR2_PACKAGE_HOST_RUSTC_TARGET_ARCH_SUPPORTS
	depends on BR2_TOOLCHAIN_HAS_THREADS
	depends on !BR2_STATIC_LIBS
	depends on BR2_PACKAGE_MESA3D_OPENGL_EGL
	depends on BR2_PACKAGE_MESA3D_GBM
	select BR2_PACKAGE_HOST_RUSTC
	select BR2_PACKAGE_LIBDRM
	select BR2_PACKAGE_LIBINPUT
	select BR2_PACKAGE_LIBXKBCOMMON
	select BR2_PACKAGE_SEATD
	select BR2_PACKAGE_WAYLAND
	select BR2_PACKAGE_WAYLAND_PROTOCOLS
	select BR2_PACKAGE_XKEYBOARD_CONFIG
	select BR2_PACKAGE_TERMINAL
	help
	  The AOS desktop environment: a Wayland compositor (ade-comp)
	  built on smithay, driving DRM/KMS directly with libinput for
	  input and logind, through libseat, for device access.

	  Clients render with Vulkan and hand the compositor a dmabuf;
	  the compositor composites with GLES and scans fullscreen
	  surfaces out directly on a KMS plane where it can.

	  Installed as a systemd unit that takes tty1, so it conflicts
	  with getty@tty1.

	  xkeyboard-config is not optional: libxkbcommon compiles the
	  keymap from its rules at startup, and with no rules present
	  the seat gets no keyboard and the compositor exits. It brings
	  no X11 with it -- its xlib selects are conditional on XORG7.

	  ade-lock, the lock screen, checks the password through
	  libpam.so.0, opened at run time, with the service file this
	  package installs at /etc/pam.d/ade-lock; linux-pam is on the
	  image for systemd. Without it the lock refuses every password
	  and the VT switch is the way out.

	  terminal is equally not optional, for a different reason: it
	  is what Super+Return and Super+T spawn, and with no terminal
	  on the image there is no way to reach a shell, shut down or
	  reboot from the session. It carries its own font, so nothing
	  font-related comes with it.

comment "ade needs a glibc toolchain w/ threads and dynamic libs, and mesa3d w/ EGL and GBM"
	depends on BR2_PACKAGE_HOST_RUSTC_TARGET_ARCH_SUPPORTS
	depends on !BR2_TOOLCHAIN_HAS_THREADS || BR2_STATIC_LIBS \
		|| !BR2_PACKAGE_MESA3D_OPENGL_EGL || !BR2_PACKAGE_MESA3D_GBM
```

## br2ext/package/alsa-ucm-conf/Config.in
```kconfig
config BR2_PACKAGE_ALSA_UCM_CONF
	bool "alsa-ucm-conf (ALSA Use Case Manager profiles)"
	depends on BR2_PACKAGE_ALSA_LIB_UCM
	help
	  The UCM2 profiles alsa-lib reads from /usr/share/alsa/ucm2: how a
	  sound card's controls are set for each use (speaker, headphones,
	  microphone). A SoundWire laptop card (sof-soundwire: Cirrus
	  amplifiers behind an Intel DSP) plays nothing without its profile
	  -- PipeWire finds the card and the amplifiers stay off.

	  https://github.com/alsa-project/alsa-ucm-conf
```

## br2ext/package/aos-desktop-file-utils/Config.in
```kconfig
config BR2_PACKAGE_AOS_DESKTOP_FILE_UTILS
	bool "desktop-file-utils (for the target)"
	depends on BR2_USE_WCHAR # libglib2
	depends on BR2_TOOLCHAIN_HAS_THREADS # libglib2
	depends on BR2_USE_MMU # libglib2
	select BR2_PACKAGE_LIBGLIB2
	help
	  update-desktop-database and desktop-file-validate on the
	  machine. Buildroot builds desktop-file-utils for the host
	  only; third-party programs expect the tools where they run --
	  Firefox runs update-desktop-database when it is made the
	  default browser, and reports an error when it is not there.

	  https://www.freedesktop.org/wiki/Software/desktop-file-utils/
```

## br2ext/package/aos-gcc/Config.in
```kconfig
config BR2_PACKAGE_AOS_GCC
	bool "aos-gcc (gcc on the target)"
	depends on BR2_x86_64
	depends on BR2_TOOLCHAIN_BUILDROOT
	depends on BR2_INSTALL_LIBSTDCPP
	select BR2_PACKAGE_BINUTILS
	select BR2_PACKAGE_BINUTILS_TARGET
	select BR2_PACKAGE_GMP
	select BR2_PACKAGE_MPFR
	select BR2_PACKAGE_MPC
	select BR2_PACKAGE_MAKE
	help
	  Builds a C and C++ compiler that runs on the target, so the
	  system can compile software on itself.

	  Buildroot deliberately does not support this -- see the note
	  in package/make/Config.in -- because a normal Buildroot image
	  is never expected to build anything. It is the whole point of
	  AOS, so we build gcc a second time here: once as the cross-
	  compiler Buildroot uses, and once as a compiler that runs on
	  the target.

	  The same gcc version and source tarball as the cross-compiler
	  is used. That is deliberate: the target already carries
	  libgcc_s and libstdc++ produced by that build, and a
	  mismatched compiler would not match its own runtime.

	  This roughly doubles the toolchain build time.

comment "aos-gcc needs an internal Buildroot toolchain w/ C++"
	depends on BR2_x86_64
	depends on !BR2_TOOLCHAIN_BUILDROOT || !BR2_INSTALL_LIBSTDCPP
```

## br2ext/package/aos-nvidia-open/Config.in
```kconfig
config BR2_PACKAGE_AOS_NVIDIA_OPEN
	bool "aos-nvidia-open (NVIDIA open kernel modules)"
	depends on BR2_x86_64
	depends on BR2_LINUX_KERNEL
	depends on BR2_TOOLCHAIN_USES_GLIBC
	help
	  NVIDIA's open GPU kernel modules: nvidia, nvidia-modeset,
	  nvidia-drm and nvidia-uvm. Dual MIT/GPL-2.0 licensed and
	  freely redistributable.

	  These are the only kernel modules NVIDIA supports for Turing
	  (RTX 20-series) and newer; for Blackwell there is no
	  proprietary kernel module alternative at all. Pre-Turing cards
	  are not supported here -- use nouveau/NVK from Mesa for those.

	  The modules alone are not enough to bring a GPU up. They load
	  GSP firmware from /lib/firmware/nvidia/<version>/, which ships
	  only in NVIDIA's installer package -- see aos-nvidia. Without
	  it, the module loads but the GPU never initialises.

	  https://github.com/NVIDIA/open-gpu-kernel-modules

comment "aos-nvidia-open needs a Linux kernel and a glibc toolchain"
	depends on BR2_x86_64
	depends on !BR2_LINUX_KERNEL || !BR2_TOOLCHAIN_USES_GLIBC
```

## br2ext/package/aos-nvidia/Config.in
```kconfig
config BR2_PACKAGE_AOS_NVIDIA
	bool "aos-nvidia (NVIDIA userspace driver and GSP firmware)"
	depends on BR2_x86_64
	depends on BR2_LINUX_KERNEL
	depends on BR2_TOOLCHAIN_USES_GLIBC
	depends on !BR2_STATIC_LIBS
	select BR2_PACKAGE_AOS_NVIDIA_OPEN
	select BR2_PACKAGE_LIBGLVND
	select BR2_PACKAGE_WAYLAND
	help
	  The userspace half of the NVIDIA driver: the EGL, OpenGL ES
	  and Vulkan vendor libraries, the EGL external platform modules
	  for Wayland and GBM, and -- critically -- the GSP firmware the
	  open kernel modules load at probe time.

	  X11/GLX components are deliberately not installed. AOS ships
	  no display server, so they would only be dangling.

	  This coexists with Mesa rather than replacing it: libglvnd
	  dispatches per-device, so the Intel or AMD GPU keeps using
	  Mesa while the NVIDIA GPU uses these libraries. That is what
	  makes a hybrid laptop work.

	  These files are covered by NVIDIA's proprietary licence, not
	  by the MIT/GPL terms of the kernel modules. NVIDIA permits
	  redistribution unmodified and with the licence included; even
	  so, this is off by default so that a stock AOS image carries
	  no proprietary code unless you ask for it.

	  https://www.nvidia.com/

comment "aos-nvidia needs a Linux kernel, a glibc toolchain, dynamic libs"
	depends on BR2_x86_64
	depends on !BR2_LINUX_KERNEL || !BR2_TOOLCHAIN_USES_GLIBC \
		|| BR2_STATIC_LIBS

if BR2_PACKAGE_AOS_NVIDIA

config BR2_PACKAGE_AOS_NVIDIA_CUDA
	bool "CUDA support"
	help
	  Install libcuda, the NVVM compiler and the PTX JIT compiler.
	  Needed to run CUDA or OpenCL workloads.

config BR2_PACKAGE_AOS_NVIDIA_SMI
	bool "nvidia-smi"
	help
	  Install the nvidia-smi management and monitoring utility.
	  Useful for confirming on a real machine that the GPU came up.

endif
```

## br2ext/package/aos-rust/Config.in
```kconfig
config BR2_PACKAGE_AOS_RUST
	bool "aos-rust (rustc + cargo on the target)"
	depends on BR2_x86_64
	depends on BR2_TOOLCHAIN_USES_GLIBC
	depends on BR2_INSTALL_LIBSTDCPP
	depends on !BR2_STATIC_LIBS
	select BR2_PACKAGE_AOS_GCC
	help
	  Installs the official upstream Rust toolchain -- rustc, cargo
	  and the x86_64-unknown-linux-gnu standard library -- into the
	  target, so the machine can build Rust software on itself.

	  Buildroot's own "rust" package is a host package used to
	  cross-compile Rust code; it puts nothing on the target. This
	  package installs the prebuilt upstream distribution rather
	  than rebuilding the compiler, which would need LLVM plus a
	  bootstrap rustc and hours of build time.

	  cargo cannot link anything without a C compiler and a linker,
	  so this selects aos-gcc, which in turn brings in binutils.

	  Note this is large: roughly 600MB installed. Turn it off for a
	  C-only image.

	  https://www.rust-lang.org

comment "rust-target needs a glibc toolchain w/ C++ and dynamic libs"
	depends on BR2_x86_64
	depends on !BR2_TOOLCHAIN_USES_GLIBC || !BR2_INSTALL_LIBSTDCPP \
		|| BR2_STATIC_LIBS

if BR2_PACKAGE_AOS_RUST

config BR2_PACKAGE_AOS_RUST_RUSTFMT
	bool "rustfmt"
	help
	  Install the rustfmt code formatter.

config BR2_PACKAGE_AOS_RUST_CLIPPY
	bool "clippy"
	help
	  Install the clippy linter.

endif
```

## br2ext/package/aos-setup/Config.in
```kconfig
config BR2_PACKAGE_AOS_SETUP
	bool "aos-setup (the graphical installer)"
	depends on BR2_PACKAGE_HOST_RUSTC_TARGET_ARCH_SUPPORTS
	depends on BR2_TOOLCHAIN_HAS_THREADS
	depends on !BR2_STATIC_LIBS
	select BR2_PACKAGE_HOST_RUSTC
	select BR2_PACKAGE_LIBXKBCOMMON
	select BR2_PACKAGE_VULKAN_LOADER
	select BR2_PACKAGE_WAYLAND
	help
	  "Install AOS": keyboard layout, time zone, the machine's account,
	  the disk, then aos-install run through sudo with its stages on a
	  progress bar and a Restart button at the end. Built on awin and
	  tgn like the Settings application, whose window it shares the
	  shape of. On the live ISO it unlocks sudo with the demo account's
	  password itself; an installed system asks.

comment "aos-setup needs a toolchain w/ threads and dynamic libs"
	depends on BR2_PACKAGE_HOST_RUSTC_TARGET_ARCH_SUPPORTS
	depends on !BR2_TOOLCHAIN_HAS_THREADS || BR2_STATIC_LIBS
```

## br2ext/package/aos-store/Config.in
```kconfig
config BR2_PACKAGE_AOS_STORE
	bool "aos-store (the app store)"
	depends on BR2_PACKAGE_HOST_RUSTC_TARGET_ARCH_SUPPORTS
	depends on BR2_TOOLCHAIN_HAS_THREADS
	depends on !BR2_STATIC_LIBS
	select BR2_PACKAGE_HOST_RUSTC
	select BR2_PACKAGE_LIBXKBCOMMON
	select BR2_PACKAGE_VULKAN_LOADER
	select BR2_PACKAGE_WAYLAND
	help
	  "Software": a graphical front to apm. Installed, Official and
	  Third-party pages with search, Install and Remove, the key the
	  index is signed with, and Updates with one button that takes
	  every package and a new AOS. Reads through apm-core as the
	  user; changes go through sudo apm, with the password asked for
	  once, like the Settings application.

comment "aos-store needs a toolchain w/ threads and dynamic libs"
	depends on BR2_PACKAGE_HOST_RUSTC_TARGET_ARCH_SUPPORTS
	depends on !BR2_TOOLCHAIN_HAS_THREADS || BR2_STATIC_LIBS
```

## br2ext/package/apm/Config.in
```kconfig
config BR2_PACKAGE_APM
	bool "apm (package manager)"
	depends on BR2_PACKAGE_HOST_RUSTC_TARGET_ARCH_SUPPORTS
	depends on BR2_TOOLCHAIN_HAS_THREADS
	depends on !BR2_STATIC_LIBS
	select BR2_PACKAGE_HOST_RUSTC
	select BR2_PACKAGE_LIBCURL_CURL
	select BR2_PACKAGE_CA_CERTIFICATES
	select BR2_PACKAGE_TAR
	help
	  The AOS package manager and the backend of its app store:
	  update, find, install, remove, upgrade against a signed index
	  of packages, some prebuilt, some vendor binaries fetched from
	  their own CDNs, some recipes compiled here with the gcc and
	  cargo the image already ships.

	  It fetches with the curl and CA bundle the image provisions
	  for exactly this, unpacks sources with tar, and never links a
	  TLS or HTTP library of its own. The store is /opt/apm; nothing
	  outside it is written except the symlink farms the store owns.

	  Installed to /usr/bin, since that is the whole of root's PATH
	  on the image. The environment files under rootfs-overlay/etc
	  put /opt/apm/bin on PATH for shells and for the desktop.
```

## br2ext/package/devmapper-udev/Config.in
```kconfig
config BR2_PACKAGE_DEVMAPPER_UDEV
	bool "devmapper-udev (libdevmapper with udev synchronisation)"
	depends on BR2_PACKAGE_LVM2
	depends on BR2_PACKAGE_HAS_UDEV
	help
	  lvm2's device-mapper library built a second time, after
	  systemd, with --enable-udev_sync, replacing the copy the lvm2
	  package installs. Buildroot cannot build lvm2 itself that way:
	  systemd (homed) needs cryptsetup, cryptsetup needs lvm2, so
	  lvm2 is built before libudev exists.

	  Without the synchronisation libdevmapper makes and removes the
	  /dev/mapper nodes itself. systemd-homed opens a home and at
	  once marks its DM device for deferred removal (it goes when the
	  home is unmounted), and libdevmapper removes the node right
	  then while the device lives on; udev's symlink had failed
	  against that node. An active home then has no /dev/mapper
	  node, and every homework run on it -- the lock screen's and
	  sudo's password check, a password change, the rebalance every
	  few minutes -- fails with "Home mount incompletely set up".
	  With the synchronisation libdevmapper leaves the nodes to
	  udev, as every distribution does.
```

## br2ext/package/files/Config.in
```kconfig
config BR2_PACKAGE_FILES
	bool "files (file explorer)"
	depends on BR2_PACKAGE_HOST_RUSTC_TARGET_ARCH_SUPPORTS
	depends on BR2_TOOLCHAIN_HAS_THREADS
	depends on !BR2_STATIC_LIBS
	select BR2_PACKAGE_HOST_RUSTC
	select BR2_PACKAGE_LIBXKBCOMMON
	select BR2_PACKAGE_VULKAN_LOADER
	select BR2_PACKAGE_WAYLAND
	help
	  The file explorer: browse, open text files in notepad, create,
	  rename, delete, copy and move, search a tree, bookmarks. Built
	  on awin (Wayland + Vulkan) and tgn like notepad and terminal,
	  so it has the same runtime needs and the same Vulkan ICD caveat
	  described under notepad.

	  It is also the file dialog: awin's dialog_open and dialog_save
	  run "files --pick" before falling back to zenity, which is not
	  on the image. Without this package notepad cannot Open or
	  Save As.

	  "Open Terminal Here" spawns "terminal --cwd <dir>", so the
	  terminal package is wanted alongside but not required.

comment "files needs a toolchain w/ threads and dynamic libs"
	depends on BR2_PACKAGE_HOST_RUSTC_TARGET_ARCH_SUPPORTS
	depends on !BR2_TOOLCHAIN_HAS_THREADS || BR2_STATIC_LIBS
```
